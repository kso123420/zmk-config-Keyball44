## config/west.yml
```yaml
manifest:
  remotes:
    - name: kso123420
      url-base: https://github.com/kso123420
    - name: kso123420
      url-base: https://github.com/kso123420
  projects:
    - name: zmk
      remote: kso123420
      revision: main
      import: app/west.yml
    - name: zmk-pmw3360-driver
      remote: kso123420
      revision: experiment3-driver
  self:
    path: config
```
